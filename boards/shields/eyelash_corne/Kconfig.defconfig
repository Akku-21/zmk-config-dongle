## boards/shields/eyelash_corne/Kconfig.defconfig
```kconfig
if SHIELD_CORNE_LEFT || SHIELD_CORNE_DONGLE_XIAO

config ZMK_KEYBOARD_NAME
    default "Corne"

config ZMK_SPLIT_ROLE_CENTRAL
    default y

# if SHIELD_CORNE_DONGLE_XIAO

# config ZMK_USB
#     default y

# endif

endif

if SHIELD_CORNE_LEFT || SHIELD_CORNE_RIGHT || SHIELD_CORNE_LEFT_PERIPHERAL || SHIELD_CORNE_DONGLE_XIAO

config ZMK_SPLIT
    default y

endif
```

## config/west.yml
```yaml
manifest:
  remotes:
    - name: zmkfirmware
      url-base: https://github.com/zmkfirmware
    - name: eyelash_corne
      url-base: https://github.com/a741725193
    - name: urob
      url-base: https://github.com/urob
    - name: akku21
      url-base: https://github.com/akku-21
    - name: carrefinho
      url-base: https://github.com/carrefinho
  projects:
    - name: zmk
      remote: zmkfirmware
      revision: main
      import: app/west.yml
    - name: zmk-adaptive-key
      remote: urob
      revision: main
    - name: zmk-auto-layer
      remote: urob
      revision: main
    - name: zmk-helpers
      remote: urob
      revision: main
    - name: zmk-leader-key
      remote: urob
      revision: main
    - name: zmk-tri-state
      remote: urob
      revision: main
    # oled Adapter
    - name: zmk-new_corne
      remote: eyelash_corne
      revision: main
    - name: nice-view-gem
      remote: akku21
      revision: main
    - name: prospector-zmk-module
      remote: carrefinho
      revision: main
    - name: zephyr
      remote: urob
      revision: v3.5.0+zmk-fixes
      clone-depth: 1
      import:
        # Only enable most commonly used boards. For less common hardware one
        # may need to enable additional modules.
        name-allowlist:
          - cmsis
          - hal_nordic
          - hal_rpi_pico
          - hal_stm32
          - lvgl
          - tinycrypt
  self:
    path: config
```
